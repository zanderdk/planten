## main/Kconfig.projbuild
```kconfig
menu "Plante Config"

config WIFI_SSID
    string "WiFi SSID"
    default "myssid"
    help
	SSID (network name) for the example to connect to.

config WIFI_PASSWORD
    string "WiFi Password"
    default "mypassword"
    help
	WiFi password (WPA or WPA2) for the example to use.

config FIRMWARE_UPGRADE_URL
    string "firmware upgrade url endpoint"
    default "https://192.168.0.3:8070/build/plante.bin"
    help
        URL of server which hosts the firmware image.

config RED_GPIO
    int "red gpio pin"
    default 15
    help
    The gpio pin that the negative side of the red led is connected to.

config GREEN_GPIO
    int "green gpio pin"
    default 4
    help
    The gpio pin that the negative side of the green led is connected to.

config BLUE_GPIO
    int "blue gpio pin"
    default 16
    help
    The gpio pin that the negative side of the blue led is connected to.
endmenu
```
